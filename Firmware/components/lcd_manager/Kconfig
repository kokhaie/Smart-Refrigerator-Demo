## Firmware/components/lcd_manager/Kconfig
```kconfig
menu "TFT Display & UI Configuration"

config LCD_ENABLED
    bool "Enable LCD Display"
    default y
    help
        Enable this to initialize and use the TFT display. If disabled, all display-related
        code will be excluded from the build.

if LCD_ENABLED

menu "Display Dimensions & Timings"
    config LCD_H_RES
        int "Horizontal Resolution (pixels)"
        default 240
        help
            The horizontal resolution of your display panel.

    config LCD_V_RES
        int "Vertical Resolution (pixels)"
        default 280
        help
            The vertical resolution of your display panel.

    config LCD_PIXEL_CLOCK_HZ
        int "Pixel Clock Speed (Hz)"
        default 10000000
        help
            The speed of the WR (write) signal. Start with a safe value like 2MHz (2000000)
            and increase for better performance. 10MHz is often stable for ST7789.
endmenu

menu "GPIO Pin Configuration"
    config LCD_PIN_CS
        int "CS (Chip Select) Pin"
        default 38
    config LCD_PIN_DC
        int "DC (Data/Command) Pin"
        default 39
    config LCD_PIN_RST
        int "RST (Reset) Pin"
        default 41
    config LCD_PIN_WR
        int "WR (Write Strobe) Pin"
        default 40
    config LCD_PIN_DATA0
        int "Data Pin 0 (DB0)"
        default 11
    config LCD_PIN_DATA1
        int "Data Pin 1 (DB1)"
        default 10
    config LCD_PIN_DATA2
        int "Data Pin 2 (DB2)"
        default 9
    config LCD_PIN_DATA3
        int "Data Pin 3 (DB3)"
        default 8
    config LCD_PIN_DATA4
        int "Data Pin 4 (DB4)"
        default 7
    config LCD_PIN_DATA5
        int "Data Pin 5 (DB5)"
        default 6
    config LCD_PIN_DATA6
        int "Data Pin 6 (DB6)"
        default 5
    config LCD_PIN_DATA7
        int "Data Pin 7 (DB7)"
        default 4

    config LCD_USE_TE_SYNC
        bool "Use Tearing Effect (TE) Pin for Sync"
        default y
        help
            Enable to use the TE pin for V-sync to prevent screen tearing.
            Recommended for smooth animation.

    if LCD_USE_TE_SYNC
    config LCD_PIN_TE
        int "TE (Tearing Effect) Pin"
        default 42
    endif
endmenu

endif
endmenu
```

## Firmware/components/motors/Kconfig
```kconfig
menu "Motor Control Configuration"

    config FAN_PIN
        int "Fan GPIO Pin"
        default 47
        help
            Select the GPIO pin connected to the fan motor driver.

    config FAN_LEDC_FREQUENCY
        int "Fan PWM Frequency (Hz)"
        default 5000
        help
            Set the PWM frequency for the fan controller.
            A value around 5000 Hz is typical to avoid audible noise.

    config VIBRATION_PIN
        int "Vibration Motor GPIO Pin"
        default 48
        help
            Select the GPIO pin connected to the vibration motor driver.

    config VIBRATION_LEDC_FREQUENCY
        int "Vibration Motor PWM Frequency (Hz)"
        default 250
        help
            Set the PWM frequency for the vibration motor. Lower frequencies can
            sometimes provide a stronger haptic effect for certain motor types.

endmenu
```

## Firmware/components/network_manager/Kconfig
```kconfig
menu "Network Manager Configuration"

    config ESP_WIFI_SSID
        string "WiFi SSID"
        default "your_ssid"
        help
            SSID of the WiFi network to connect to.

    config ESP_WIFI_PASSWORD
        string "WiFi Password"
        default "your_password"
        help
            Password of the WiFi network.

    config ESP_MAXIMUM_RETRY
        int "Maximum Wifi Connection Retries"
        default 5
        help
            Set the number of retries for WiFi connection.

    config MQTT_BROKER_URI
        string "MQTT Broker URI"
        default "mqtt://mqtt.eclipseprojects.io"
        help
            The URI of the MQTT broker to connect to.

    config MQTT_TOPIC
        string "MQTT Topic"
        default "/topic/test"
        help
            The MQTT topic to subscribe to.

    config MQTT_USERNAME
        string "MQTT Username"
        default ""
        help
            The MQTT Username.

    config MQTT_PASSWORD
        string "MQTT Password"
        default ""
        help
            The MQTT Password.

endmenu
```

## Firmware/components/sensor_manager/Kconfig
```kconfig
menu "Sensor Manager Configuration"

    config I2C_MASTER_SDA_IO
        int "I2C Master SDA GPIO Pin"
        default 15
        help
            GPIO pin to use for I2C SDA line.

    config I2C_MASTER_SCL_IO
        int "I2C Master SCL GPIO Pin"
        default 16
        help
            GPIO pin to use for I2C SCL line.

    config I2C_MASTER_FREQ_HZ
        int "I2C Master Clock Speed (Hz)"
        default 400000
        help
            I2C clock frequency. 400000 for Fast Mode is recommended.

    menu "MPU6050 Accelerometer/Gyro"
        config ENABLE_MPU6050
            bool "Enable MPU6050 Sensor"
            default y
            help
                Enable this to include the MPU6050 driver.

        config MPU6050_CALIBRATE_ON_START
            bool "Calibrate MPU6050 on Startup"
            depends on ENABLE_MPU6050
            default n
            help
                If enabled, the MPU6050 will perform a calibration routine at startup.
                The device must be kept flat and still during this time.
    endmenu

    menu "INA226 Current/Voltage Sensor"
        config ENABLE_INA226
            bool "Enable INA226 Sensor"
            default y
            help
                Enable this to include the INA226 driver.

        config INA226_SHUNT_RESISTANCE_MILLIOHMS
            int "Shunt Resistor Value (in milli-Ohms)"
            depends on ENABLE_INA226
            default 100
            help
                The value of the shunt resistor in milli-Ohms (e.g., enter 100 for 0.1 Ohms).

        config INA226_MAX_CURRENT_MILLIAMPS
            int "Max Expected Current (in milli-Amps)"
            depends on ENABLE_INA226
            default 3200
            help
                The maximum current you expect to measure in milli-Amps (e.g., enter 3200 for 3.2 Amps).
    endmenu

    menu "SHTC3 Temperature/Humidity Sensor"
        config ENABLE_SHTC3
            bool "Enable SHTC3 Sensor"
            default y
            help
                Enable this to include the SHTC3 driver.
    endmenu

endmenu
```

## Firmware/components/touch_slider/Kconfig
```kconfig
menu "Touch Slider Config"

    config TOUCH_SLIDER_PAD1_CHANNEL
        int "Touch Pad 1 Channel Number"
        default 1
        help
            The touch channel number (e.g., 4 for TOUCH_PAD_NUM4) for the first slider pad.

    config TOUCH_SLIDER_PAD2_CHANNEL
        int "Touch Pad 2 Channel Number"
        default 2
        help
            The touch channel number for the second slider pad.

    config TOUCH_SLIDER_PAD3_CHANNEL
        int "Touch Pad 3 Channel Number"
        default 12
        help
            The touch channel number for the third slider pad.

    config TOUCH_SLIDER_PAD4_CHANNEL
        int "Touch Pad 4 Channel Number"
        default 13
        help
            The touch channel number for the fourth slider pad.

    config TOUCH_SLIDER_PAD5_CHANNEL
        int "Touch Pad 5 Channel Number"
        default 14
        help
            The touch channel number for the fifth slider pad.

endmenu
```
